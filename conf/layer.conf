## conf/layer.conf
```bitbake
# We have a conf and classes directory, add to BBPATH
BBPATH .= ":${LAYERDIR}"

# We have recipes-* directories, add to BBFILES
BBFILES += "${LAYERDIR}/recipes-*/*/*.bb \
            ${LAYERDIR}/recipes-*/*/*.bbappend"

BBFILE_COLLECTIONS += "u2up_homegw"
BBFILE_PATTERN_u2up_homegw = "^${LAYERDIR}/"
BBFILE_PRIORITY_u2up_homegw = "9"

LAYERSERIES_COMPAT_u2up_homegw = "thud"
```
